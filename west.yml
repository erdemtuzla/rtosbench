## west.yml
```yaml
manifest:
  self:
    path: zephyr-rtosbench

  remotes:
    - name: zephyrproject-rtos
      url-base: https://github.com/zephyrproject-rtos
    - name: rtosbench
      url-base: https://github.com/methodpark

  projects:
    - name: zephyr
      remote: zephyrproject-rtos
      revision: zephyr-v3.1.0
      import: true
    - name: RTOSBench
      path: zephyr-rtosbench/app/lib/rtosbench
      remote: rtosbench
```
